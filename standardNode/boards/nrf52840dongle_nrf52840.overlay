/ {
    aliases {
            led0 = &myled;
    };

    leds {
            compatible = "gpio-leds";
            myled: led_3 {
                    gpios = <&gpio0 0xc GPIO_ACTIVE_LOW>;
            };
    };
};